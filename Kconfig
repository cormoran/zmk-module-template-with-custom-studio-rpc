## Kconfig
```kconfig
config ZMK_TEMPLATE_FEATURE
    bool "Enable template feature"

if ZMK_TEMPLATE_FEATURE

config ZMK_TEMPLATE_FEATURE_STUDIO_RPC
    bool "Enable template feature custom Studio RPC"
    depends on ZMK_STUDIO

config ZMK_TEMPLATE_FEATURE_SPLIT_RELAY
    bool "Relay the sample RPC value to the split peripheral"
    depends on ZMK_SPLIT
    select ZMK_SPLIT_RELAY_EVENT
    help
      Sample of ZMK's split event-relay: when the sample custom Studio RPC
      arrives on the split central, forward the received value to the split
      peripheral(s) as a plain packed C struct (see
      include/your-name/template/template_relay.h). A peripheral-side listener
      decodes it and logs one line. Enable on BOTH split halves. Requires the
      central to also have ZMK_TEMPLATE_FEATURE_STUDIO_RPC for the RPC that
      triggers the relay.

endif
```
